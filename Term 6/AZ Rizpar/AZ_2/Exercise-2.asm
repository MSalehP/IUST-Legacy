.include "m32def.inc"
		;MOHAMMAD SALEH PAZHAND 400521171

		LDI		R16,HIGH(RAMEND)
		OUT		SPH,R16
		LDI		R16,LOW(RAMEND)
		OUT		SPL,R16

		LDI		R16,0xFF
		OUT		DDRC,R16
		OUT		DDRD,R16
		OUT     PORTA,R16
		LDI		R16,0
		OUT 	DDRA,R1
		LDI 	R20,0
		LDI 	R21,0
		LDI 	R22,0
		LDI 	R23,0
		
START:
		LDI     R25,0X10
SHOWER:	
		CALL    DISPLAY

		CPI     R25,0X00
		BREQ    CALCULATE
		DEC 	R25
		RJMP 	SHOWER

CALCULATE:
		IN  	R26,PINA
		SBRC	R26,0
		CALL    DEC_REG1
		SBRS 	R26,0
		CALL	INC_REG1
		RJMP    START

DISPLAY:
		;Display the 1st Segment
		LDI		R16,0b11110111
		OUT		PORTD,R16
		MOV		R16,R20
		CALL	CONVERT
		OUT		PORTC,R16
		CALL	DELAY

		;Display the 2nd Segment
		LDI		R16,0b11111011
		OUT		PORTD,R16
		MOV		R16,R21
		CALL	CONVERT
		OUT		PORTC,R16
		CALL	DELAY

		;Display the 3rd Segment
		LDI		R16,0b11111101
		OUT		PORTD,R16
		MOV		R16,R22
		CALL	CONVERT
		OUT		PORTC,R16
		CALL	DELAY

		;Display the 4th Segment
		LDI		R16,0b11111110
		OUT		PORTD,R16
		MOV		R16,R23
		CALL	CONVERT		
		OUT		PORTC,R16
		CALL	DELAY
		RET


DELAY:	LDI		R17,0x12
D1:		LDI		R18,0xFF
D2:		DEC		R18
		BRNE	D2
		DEC		R17
		BRNE	D1
		RET

CONVERT:
		CPI		R16,0
		BRNE	C1
		LDI		R16,0x3F
		RET
C1:		CPI		R16,1
		BRNE	C2
		LDI		R16,0x06
		RET	
C2:		CPI		R16,2
		BRNE	C3
		LDI		R16,0x5B
		RET
C3:		CPI		R16,3
		BRNE	C4
		LDI		R16,0x4F
		RET
C4:		CPI		R16,4
		BRNE	C5
		LDI		R16,0x66
		RET
C5:		CPI		R16,5
		BRNE	C6
		LDI		R16,0x6D
		RET
C6:		CPI		R16,6
		BRNE	C7
		LDI		R16,0x7D
		RET
C7:		CPI		R16,7
		BRNE	C8
		LDI		R16,0x07
		RET
C8:		CPI		R16,8
		BRNE	C9
		LDI		R16,0x7F
		RET
C9:		CPI		R16,9
		BRNE	C10
		LDI		R16,0x6F
C10:	RET



DEC_REG1:
		CPI		R20,0
		BREQ	DEC_REG2
		DEC		R20
		RET
DEC_REG2:
		LDI     R20,9
		CPI		R21,0
		BREQ	DEC_REG3
		DEC		R21
		RET
DEC_REG3:
		LDI     R21,9
		CPI		R22,0
		BREQ	DEC_REG4
		DEC		R22
		RET
DEC_REG4:
		LDI     R22,9
		CPI		R23,0
		BREQ	START_DEC_1
		DEC		R23
		RET
INC_REG1:
		CPI		R20,9
		BREQ	INC_REG2
		INC		R20
		RET
INC_REG2:
		LDI		R20,0
		CPI		R21,9
		BREQ	INC_REG3
		INC		R21
		RET
INC_REG3:
		LDI		R21,0
		CPI		R22,9
		BREQ	INC_REG4
		INC		R22
		RET
INC_REG4:
		LDI		R22,0
		CPI		R23,9
		BREQ	START_INC_1
		INC		R23
		RET

START_DEC_1:
		LDI 	R20,9
		LDI 	R21,9
		LDI 	R22,9
		LDI 	R23,9
        RJMP 	START
START_INC_1:
		LDI 	R20,0
		LDI 	R21,0
		LDI 	R22,0
		LDI 	R23,0
		RJMP  	START



START_DEC:
		LDI 	R20,9
		LDI 	R21,9
		LDI 	R22,9
		LDI 	R23,9
        JMP 	START
START_INC:
		LDI 	R20,0
		LDI 	R21,0
		LDI 	R22,0
		LDI 	R23,0
		JMP  	START

